## conf/layer.conf
```bitbake
# We have a conf and classes directory, add to BBPATH
BBPATH .= ":${LAYERDIR}"

# We have recipes-* directories, add to BBFILES
BBFILES += "${LAYERDIR}/recipes-*/*/*.bb \
	    ${LAYERDIR}/recipes-*/*/*.bbappend"

BBFILE_COLLECTIONS += "enpg"
BBFILE_PATTERN_enpg = "^${LAYERDIR}/"
BBFILE_PRIORITY_enpg = "11"

LAYERSERIES_COMPAT_enpg = "kirkstone"

# This should only be incremented on significant changes that will
# cause compatibility issues with other layers
LAYERVERSION_enpg = "1"

LAYERDEPENDS_enpg = "core"
```
